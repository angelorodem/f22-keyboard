## Kconfig
```kconfig
menu "F22 debug probes"

config F22_DEBUG_PROBE
    bool "Enable F22 debug probes"
    default n

if F22_DEBUG_PROBE

config F22_DEBUG_PROBE_BLINK
    bool "Blink led0 from application context"
    depends on GPIO
    help
      Toggle the led0 alias from a kernel timer to confirm the system reaches
      application context without relying on USB bring-up.

config F22_DEBUG_PROBE_USB_STATE
    bool "Show USB device state on led0"
    depends on GPIO && USB_DEVICE_STACK
    help
      Drive the led0 alias with a repeating blink pattern after usb_enable().

config F22_DEBUG_PROBE_USB_ARMED
    bool "Link USB stack but never call usb_enable"
    depends on GPIO && USB_DEVICE_STACK
    help
      Pulls in the Zephyr USB device stack and the RP2350 USB driver so they
      are linked and statically initialized, but does not call usb_enable.
      Used to check whether merely linking USB code is enough to crash boot.

config F22_DEBUG_PROBE_USB_RAW
    bool "Call usb_enable from a thread after blinking"
    depends on GPIO && USB_DEVICE_STACK
    help
      Run from a kernel thread (not SYS_INIT) so the LED is guaranteed to
      blink before usb_enable is called. Useful to localize whether
      usb_enable itself faults.

config F22_DEBUG_PROBE_USB_INIT_BRACKET
    bool "Bracket USB controller init priority with led0"
    depends on GPIO && USB_DEVICE_STACK
    help
      Drives led0 off just before the default device init priority and on just
      after it. Used with a GPIO hog and application blink probe to determine
      whether boot stops inside the RP Pico USB controller init.

config F22_DEBUG_PROBE_USB_INIT_LADDER
    bool "Ladder of led0 pulse groups at increasing init priorities"
    depends on GPIO && USB_DEVICE_STACK
    help
      Registers SYS_INIT hooks at multiple POST_KERNEL and APPLICATION
      priorities. Each hook pulses led0 N times and leaves it on, where N
      matches the priority step. The last pulse group observed before the LED
      goes solid identifies the last priority reached before boot stalls.

config F22_DEBUG_PROBE_USB_APP_LADDER
    bool "Narrow led0 pulse ladder for application init priorities"
    depends on GPIO && USB_DEVICE_STACK
    help
      Registers SYS_INIT hooks after APPLICATION priority 50 and around the
      default application init priority. Used after the broad ladder shows boot
      reaches APPLICATION priority 50 but stalls before late application init.

config F22_DEBUG_PROBE_USB_ENABLE_GATE
    bool "Ladder through early USB enable with led0"
    depends on GPIO && USB_DEVICE_STACK
    help
      Replays the public, early steps of usb_enable() with a numbered LED
      pulse before each step. Used after controller attach succeeds to find
      which part of USB stack enable hangs before EP0 starts handling traffic.

endif

endmenu
```

## boards/custom/rp2354_split/Kconfig.defconfig
```kconfig
if BOARD_RP2354_SPLIT_LEFT || BOARD_RP2354_SPLIT_LEFT_RP2350B_M33 || BOARD_RP2354_SPLIT_LEFT_RP2350B_M33_ZMK

config ZMK_KEYBOARD_NAME
    default "F22 Split"

config ZMK_SPLIT_ROLE_CENTRAL
    default y

endif

if BOARD_RP2354_SPLIT_RIGHT || BOARD_RP2354_SPLIT_RIGHT_RP2350B_M33 || BOARD_RP2354_SPLIT_RIGHT_RP2350B_M33_ZMK

config ZMK_KEYBOARD_NAME
    default "F22 Split RT"

endif

if BOARD_RP2354_SPLIT_LEFT || BOARD_RP2354_SPLIT_LEFT_RP2350B_M33 || BOARD_RP2354_SPLIT_LEFT_RP2350B_M33_ZMK || BOARD_RP2354_SPLIT_RIGHT || BOARD_RP2354_SPLIT_RIGHT_RP2350B_M33 || BOARD_RP2354_SPLIT_RIGHT_RP2350B_M33_ZMK

config BOARD
    default "rp2354_split"

config ZMK_SPLIT
    default y

config ZMK_SPLIT_WIRED
    default y

endif
```

## boards/custom/rp2354_split/Kconfig.rp2354_split_left
```kconfig
config BOARD_RP2354_SPLIT_LEFT
    select SOC_RP2350B_M33 if BOARD_RP2354_SPLIT_LEFT_RP2350B_M33 || BOARD_RP2354_SPLIT_LEFT_RP2350B_M33_ZMK
    select ZMK_BOARD_COMPAT
    imply RETAINED_MEM
    imply RETENTION
    imply RETENTION_BOOT_MODE
```

## boards/custom/rp2354_split/Kconfig.rp2354_split_right
```kconfig
config BOARD_RP2354_SPLIT_RIGHT
    select SOC_RP2350B_M33 if BOARD_RP2354_SPLIT_RIGHT_RP2350B_M33 || BOARD_RP2354_SPLIT_RIGHT_RP2350B_M33_ZMK
    select ZMK_BOARD_COMPAT
    imply RETAINED_MEM
    imply RETENTION
    imply RETENTION_BOOT_MODE
```

## boards/custom/rp2354_split/board.yml
```yaml
boards:
  - name: rp2354_split_left
    vendor: custom
    socs:
      - name: rp2350b
        variants:
          - name: zmk
            cpucluster: m33
  - name: rp2354_split_right
    vendor: custom
    socs:
      - name: rp2350b
        variants:
          - name: zmk
            cpucluster: m33
```

## boards/custom/rp2354_split/rp2354_split_left_rp2350b_m33_zmk_defconfig
```kconfig
CONFIG_ARM_MPU=y
CONFIG_BUILD_OUTPUT_UF2=y
CONFIG_CLOCK_CONTROL=y
CONFIG_SYS_CLOCK_HW_CYCLES_PER_SEC=150000000
CONFIG_FLASH=y
CONFIG_FLASH_MAP=y
CONFIG_FLASH_PAGE_LAYOUT=y
CONFIG_GPIO=y
CONFIG_MPU_ALLOW_FLASH_WRITE=y
CONFIG_NVS=y
CONFIG_PINCTRL=y
CONFIG_RESET=y
CONFIG_SERIAL=y
CONFIG_SETTINGS=y
CONFIG_SETTINGS_NVS=y
CONFIG_UART_INTERRUPT_DRIVEN=y
CONFIG_USE_DT_CODE_PARTITION=y

CONFIG_USB_DEVICE_STACK=y
CONFIG_ZMK_USB=y

CONFIG_ZMK_KSCAN_MATRIX_POLLING=y
CONFIG_ZMK_HID_REPORT_TYPE_NKRO=y
CONFIG_ZMK_HID_CONSUMER_REPORT_USAGES_BASIC=y

CONFIG_USB_DEVICE_MANUFACTURER="F22"
```

## boards/custom/rp2354_split/rp2354_split_right_rp2350b_m33_zmk_defconfig
```kconfig
CONFIG_ARM_MPU=y
CONFIG_BUILD_OUTPUT_UF2=y
CONFIG_CLOCK_CONTROL=y
CONFIG_SYS_CLOCK_HW_CYCLES_PER_SEC=150000000
CONFIG_GPIO=y
CONFIG_MPU_ALLOW_FLASH_WRITE=y
CONFIG_PINCTRL=y
CONFIG_RESET=y
CONFIG_SERIAL=y
CONFIG_UART_INTERRUPT_DRIVEN=y
CONFIG_USE_DT_CODE_PARTITION=y

CONFIG_ZMK_KSCAN_MATRIX_POLLING=y
CONFIG_ZMK_HID_REPORT_TYPE_HKRO=y
CONFIG_ZMK_HID_CONSUMER_REPORT_USAGES_BASIC=y
```

## soc/custom/rp2350b/Kconfig.soc
```kconfig
# RP2350B SoC Kconfig (Zephyr v4.1 compatibility shim)
# SPDX-License-Identifier: Apache-2.0

config SOC_FAMILY_RPI_PICO
	bool

config SOC_FAMILY
	default "rpi_pico" if SOC_FAMILY_RPI_PICO

config SOC_SERIES_RP2350
	bool
	select SOC_FAMILY_RPI_PICO

config SOC_SERIES
	default "rp2350" if SOC_SERIES_RP2350

config SOC_RP2350B
	bool
	select SOC_SERIES_RP2350

config SOC_RP2350B_M33
	bool
	select SOC_RP2350B
	help
	  Use the RP2350B with a Cortex-M33 core in both 'sockets'.

config SOC
	default "rp2350b" if SOC_RP2350B
```
