/ {
    chosen {
        zephyr,console = &uart0;
        zephyr,shell-uart = &uart0;
    };

    wired_split {
        status = "disabled";
    };

    indicators {
        status = "disabled";
    };
};
